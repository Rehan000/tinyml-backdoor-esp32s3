/*
 * qsentry_bench.cpp -- On-device measurement harness for the ESP32-S3 (ESP-DL).
 *
 * Measures the paper's on-device cost (contribution C1):
 *   - latency : esp_timer_get_time() around each region
 *   - peak RAM: heap_caps free internal + PSRAM, before/after model load
 *   - energy  : MARK_GPIO raised around each region so an external Nordic PPK2 segments energy
 *
 * Regions: (1) INT8 model inference, (2) inference + the C3 class-conditional activation monitor.
 * The delta is the defense's measured overhead. Per the simplified plan (firmware/README.md) the
 * monitor is benchmarked over a 64-float feature buffer (its real O(d) compute); on-device
 * detection accuracy is a host-side result, so we do not extract intermediate features here.
 */
#include <stdio.h>
#include <string.h>
#include <math.h>
#include "freertos/FreeRTOS.h"
#include "freertos/task.h"
#include "esp_timer.h"
#include "esp_heap_caps.h"
#include "driver/gpio.h"
#include "esp_log.h"
#include "dl_model_base.hpp"
#include "dl_tensor_base.hpp"
#include "testset.h"

#define MARK_GPIO_INF   GPIO_NUM_4   /* PPK2 logic D0: high during the inference-only region   */
#define MARK_GPIO_DEF   GPIO_NUM_5   /* PPK2 logic D1: high during the inference + monitor region */
#define N_WARMUP        20
#define N_ITERS         200
#define N_CCM_REPEAT    1024         /* monitor calls per inference in region B (energy amplification:
                                        makes the ~0.8%/inf CCM cost a large, directly-measurable hump
                                        in the current trace, so logic markers are not required) */
#define MONITOR_DIM     64
#define N_CLASSES       4
#define TIER1_CLIP_K    8.0f

static const char *TAG = "qsentry";

/* C3 detector params, generated by code/export_monitor.py (monitor_params.c, C linkage) */
extern "C" {
extern const float g_median[N_CLASSES][MONITOR_DIM];
extern const float g_inv_mad[N_CLASSES][MONITOR_DIM];
}

/* Embedded INT8 model (model/model.espdl via EMBED_FILES) */
extern const uint8_t model_espdl_start[] asm("_binary_model_espdl_start");

static dl::Model *g_model = nullptr;

static inline void mark(gpio_num_t pin, int level) { gpio_set_level(pin, level); }

static int tensor_numel(dl::TensorBase *t) {
    int n = 1;
    for (int d : t->shape) n *= d;
    return n;
}

/* Run one INT8 inference on a float signal; return argmax class. */
static int model_infer(const float *signal, dl::runtime_mode_t mode = dl::RUNTIME_MODE_SINGLE_CORE) {
    auto &ins = g_model->get_inputs();
    dl::TensorBase *in = ins.begin()->second;
    const float scale = exp2f((int)in->exponent);          // real = q * 2^exponent
    int8_t *q = (int8_t *)in->data;
    int n = tensor_numel(in);
    for (int i = 0; i < n; ++i) {
        int v = (int)lroundf(signal[i] / scale);
        q[i] = (int8_t)(v > 127 ? 127 : (v < -128 ? -128 : v));
    }
    g_model->run(mode);
    auto &outs = g_model->get_outputs();
    dl::TensorBase *out = outs.begin()->second;
    int8_t *o = (int8_t *)out->data;                       // argmax is scale-invariant
    int m = tensor_numel(out), best = 0;
    for (int i = 1; i < m; ++i) if (o[i] > o[best]) best = i;
    return best;
}

/* C3 class-conditional activation-OOD score over the penultimate features (matches tinybd.defense) */
static float tier1_score(const float *gap, int pred_class) {
    const float *md = g_median[pred_class];
    const float *iv = g_inv_mad[pred_class];
    float acc = 0.0f;
    for (int d = 0; d < MONITOR_DIM; ++d) {
        float z = fabsf(gap[d] - md[d]) * iv[d];
        if (z > TIER1_CLIP_K) z = TIER1_CLIP_K;
        acc += z;
    }
    return acc / (float)MONITOR_DIM;
}

extern "C" void app_main(void) {
    gpio_reset_pin(MARK_GPIO_INF);
    gpio_set_direction(MARK_GPIO_INF, GPIO_MODE_OUTPUT);
    gpio_set_level(MARK_GPIO_INF, 0);
    gpio_reset_pin(MARK_GPIO_DEF);
    gpio_set_direction(MARK_GPIO_DEF, GPIO_MODE_OUTPUT);
    gpio_set_level(MARK_GPIO_DEF, 0);

    size_t int_before = heap_caps_get_free_size(MALLOC_CAP_INTERNAL);
    size_t psram_before = heap_caps_get_free_size(MALLOC_CAP_SPIRAM);
    g_model = new dl::Model((const char *)model_espdl_start, fbs::MODEL_LOCATION_IN_FLASH_RODATA);
    size_t int_after = heap_caps_get_free_size(MALLOC_CAP_INTERNAL);
    size_t psram_after = heap_caps_get_free_size(MALLOC_CAP_SPIRAM);
    ESP_LOGI(TAG, "model RAM: internal=%d B  psram=%d B",
             (int)(int_before - int_after), (int)(psram_before - psram_after));

    /* input buffer (zeros here; load a real test sample for accuracy validation) */
    int in_n = tensor_numel(g_model->get_inputs().begin()->second);
    static float input[2048];
    if (in_n > 2048) in_n = 2048;
    memset(input, 0, sizeof(input));
    /* use a real CWRU test window as the input for the measured regions (compute is
       data-independent, but this keeps the energy run representative of deployment) */
    if (N_TEST > 0) memcpy(input, g_test_x[0], sizeof(float) * (in_n < SIG_LEN ? in_n : SIG_LEN));
    static float gap_buf[MONITOR_DIM];
    memset(gap_buf, 0, sizeof(gap_buf));

    int pred = 0;
    for (int i = 0; i < N_WARMUP; ++i) pred = model_infer(input);

    /* Deployment-correctness check: device INT8 vs host FP32 on embedded test samples. */
    int correct = 0, agree = 0, host_correct = 0;
    for (int i = 0; i < N_TEST; ++i) {
        int p = model_infer(g_test_x[i]);
        if (p == g_test_y[i]) correct++;
        if (p == g_test_pred_fp[i]) agree++;
        if (g_test_pred_fp[i] == g_test_y[i]) host_correct++;
    }
    ESP_LOGI(TAG, "accuracy: device_INT8=%.3f  host_FP32=%.3f  device_vs_host_agree=%.3f  (N=%d)",
             (double)correct / N_TEST, (double)host_correct / N_TEST, (double)agree / N_TEST, N_TEST);

    /* one-shot dual-core latency (the energy loop below is single-core only, to keep the
       current trace to two clean humps per round) */
    int64_t td0 = esp_timer_get_time();
    for (int i = 0; i < N_ITERS; ++i) pred = model_infer(input, dl::RUNTIME_MODE_MULTI_CORE);
    ESP_LOGI(TAG, "dual-core latency: %.2f us/inf", (double)(esp_timer_get_time() - td0) / N_ITERS);

    /* Energy loop. Two regions per round, each preceded by an idle baseline:
         Region A (D0/GPIO4): inference x N_ITERS                       -> ~1 s hump
         Region B (D1/GPIO5): inference + N_CCM_REPEAT monitor calls    -> long hump
       Because B runs the monitor N_CCM_REPEAT times per inference, (E_B - E_A) is the energy of
       N_ITERS*N_CCM_REPEAT monitor calls -- large and directly measurable from the current trace,
       so the result does NOT depend on the logic markers (they are still raised, as a cross-check).
       The inference (E_A) cancels in the subtraction; the class index cycles 0..3 so the compiler
       cannot hoist the repeated monitor call. */
    float acc = 0.0f; volatile float sink = 0.0f; int cc = 0;
    for (int round = 0; ; ++round) {
        vTaskDelay(pdMS_TO_TICKS(1500));

        /* Region A: inference only */
        int64_t t0 = esp_timer_get_time();
        mark(MARK_GPIO_INF, 1);
        for (int i = 0; i < N_ITERS; ++i) pred = model_infer(input);
        mark(MARK_GPIO_INF, 0);
        int64_t t_infer = esp_timer_get_time() - t0;

        vTaskDelay(pdMS_TO_TICKS(1500));

        /* Region B: inference + amplified monitor */
        t0 = esp_timer_get_time();
        mark(MARK_GPIO_DEF, 1);
        for (int i = 0; i < N_ITERS; ++i) {
            pred = model_infer(input);
            for (int r = 0; r < N_CCM_REPEAT; ++r)
                acc += tier1_score(gap_buf, (cc++) & (N_CLASSES - 1));
        }
        mark(MARK_GPIO_DEF, 0);
        int64_t t_def = esp_timer_get_time() - t0;
        sink = acc;  /* defeat dead-code elimination */

        double per_ccm_us = (double)(t_def - t_infer) / ((double)N_ITERS * N_CCM_REPEAT);
        ESP_LOGI(TAG, "[round %d] infer: %.2f us/inf | infer+%dxCCM: %.2f us/inf | per-CCM: %.3f us | "
                 "pred=%d sink=%.0f", round, (double)t_infer / N_ITERS, N_CCM_REPEAT,
                 (double)t_def / N_ITERS, per_ccm_us, pred, (double)sink);
        vTaskDelay(pdMS_TO_TICKS(3000));
    }
}
